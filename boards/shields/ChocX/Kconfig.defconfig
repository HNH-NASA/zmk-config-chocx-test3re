## boards/shields/ChocX/Kconfig.defconfig
```kconfig
if SHIELD_CHOCX_R

config ZMK_KEYBOARD_NAME
    default "ChocX"

config ZMK_SPLIT_ROLE_CENTRAL
    default y

config ZMK_POINTING
    default y

config AZ1UBALL
    default y

config I2C
    default y


endif # SHIELD_CHOCX_R

if SHIELD_CHOCX_R || SHIELD_CHOCX_L

config ZMK_SPLIT
    default y

config SPI
    default y

endif # SHIELD_CHOCX_R || SHIELD_CHOCX_L
```

## boards/shields/ChocX/Kconfig.shield
```kconfig
config SHIELD_CHOCX_L
    def_bool $(shields_list_contains,ChocX_L)

config SHIELD_CHOCX_R
    def_bool $(shields_list_contains,ChocX_R)
```
